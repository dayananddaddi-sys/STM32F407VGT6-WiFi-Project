#include "oled.h"

const uint8_t font6x8[][6] = {
		// SPACE to '/'
		    {0x00,0x00,0x00,0x00,0x00,0x00}, // 0x20 ' '
		    {0x00,0x00,0x5F,0x00,0x00,0x00}, // 0x21 '!'
		    {0x00,0x07,0x00,0x07,0x00,0x00}, // 0x22 '"'
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		    {0x20,0x10,0x08,0x04,0x02,0x00}, // 0x2F '/'

		    // 0 to 9
		    {0x3E,0x51,0x49,0x45,0x3E,0x00}, // 0x30 '0'
		    {0x00,0x42,0x7F,0x40,0x00,0x00}, // 0x31 '1'
		    {0x42,0x61,0x51,0x49,0x46,0x00}, // 0x32 '2'
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		    {0x06,0x49,0x49,0x29,0x1E,0x00}, // 0x39 '9'

		    // ':' to '@'
		    {0x00,0x36,0x36,0x00,0x00,0x00}, // 0x3A ':'
		    {0x00,0x56,0x36,0x00,0x00,0x00}, // 0x3B ';'
		    {0x08,0x14,0x22,0x41,0x00,0x00}, // 0x3C '<'
		    {0x14,0x14,0x14,0x14,0x14,0x00}, // 0x3D '='
		    {0x00,0x41,0x22,0x14,0x08,0x00}, // 0x3E '>'
		    {0x02,0x01,0x51,0x09,0x06,0x00}, // 0x3F '?'
		    {0x32,0x49,0x79,0x41,0x3E,0x00}, // 0x40 '@'

		    // A to Z
		    {0x7E,0x11,0x11,0x11,0x7E,0x00}, // 0x41 'A'
		    {0x7F,0x49,0x49,0x49,0x36,0x00}, // 0x42 'B'
		    {0x3E,0x41,0x41,0x41,0x22,0x00}, // 0x43 'C'
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		    {0x61,0x51,0x49,0x45,0x43,0x00}, // 0x5A 'Z'

		    // '[' to '`'
		    {0x00,0x7F,0x41,0x41,0x00,0x00}, // 0x5B '['
		    {0x02,0x04,0x08,0x10,0x20,0x00}, // 0x5C '\'
		    {0x00,0x41,0x41,0x7F,0x00,0x00}, // 0x5D ']'
		    {0x04,0x02,0x01,0x02,0x04,0x00}, // 0x5E '^'
		    {0x40,0x40,0x40,0x40,0x40,0x00}, // 0x5F '_'
		    {0x00,0x01,0x02,0x04,0x00,0x00}, // 0x60 '`'

		    // a to z
		    {0x20,0x54,0x54,0x54,0x78,0x00}, // 0x61 'a'
		    {0x7F,0x48,0x44,0x44,0x38,0x00}, // 0x62 'b'
		    {0x38,0x44,0x44,0x44,0x20,0x00}, // 0x63 'c'
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		    {0x44,0x64,0x54,0x4C,0x44,0x00}, // 0x7A 'z'

		    // '{' to '~'
		    {0x00,0x08,0x36,0x41,0x00,0x00}, // 0x7B '{'
		    {0x00,0x00,0x7F,0x00,0x00,0x00}, // 0x7C '|'
		    {0x00,0x41,0x36,0x08,0x00,0x00}, // 0x7D '}'
		    {0x08,0x08,0x2A,0x1C,0x08,0x00}  // 0x7E '~'
};

void OLED_SetCursor(uint8_t page, uint8_t col) {
    OLED_SendCommand(0xB0 + page);           // Set page address
    OLED_SendCommand(0x00 + (col & 0x0F));   // Lower column start address
    OLED_SendCommand(0x10 + ((col >> 4) & 0x0F)); // Upper column start address
}

void OLED_RangeClear(uint8_t page, uint8_t col) {
    OLED_SendCommand(0xB0 + page);           // Set page address
    OLED_SendCommand(0x00 + (col & 0x0F));   // Lower column start address
    OLED_SendCommand(0x10 + ((col >> 4) & 0x0F));// Upper column start address

    OLED_PrintString(" ");
}

void OLED_PrintChar(char ch) {
    if (ch < 32 || ch > 127) return;  // Ignore unsupported characters

    for (uint8_t i = 0; i < 6; i++) {
        OLED_SendData(font6x8[ch - 32][i]);
    }
}

void OLED_PrintString(char *str) {
    while (*str) {
        OLED_PrintChar(*str++);
    }
}

void OLED_Clear(void) {
    for (uint8_t page = 0; page < 8; page++) {
        OLED_SetCursor(page, 0);
        for (uint8_t col = 0; col < 128; col++) {
            OLED_SendData(0x00);
        }
    }
}

void OLED_rClear(uint8_t page, uint8_t col2) {
    for (uint8_t page2 = page; page2 < 8; page2++) {
        OLED_SetCursor(page2, 0);
        for (uint8_t col = 0; col < col2; col++) {
            OLED_SendData(0x00);
        }
    }
}

void oled_update_pixel(uint8_t page, uint8_t column, uint8_t data) {
    // Set the address
	 OLED_SendCommand(0xB0 | page);
    OLED_SendCommand(0x00 | (column & 0x0F));
    OLED_SendCommand(0x10 | ((column >> 4) & 0x0F));
    // Send the data
    OLED_SendData(data);
}

// Function to display an image on OLED
void OLED_DisplayImage(const uint8_t *image) {
    for (uint8_t page = 0; page < 8; page++) { // 8 pages for 64-pixel height (each page = 8 pixels)
        OLED_SendCommand(0xB0 + page);  // Set page address
        OLED_SendCommand(0x00);         // Set lower column address
        OLED_SendCommand(0x10);         // Set higher column address

        for (uint8_t col = 0; col < 128; col++) { // 128 columns for width
            OLED_SendData(image[page * 128 + col]);
        }
    }
}

void OLED_Init(void) {
    OLED_SendCommand(0xAE); // Display OFF
    OLED_SendCommand(0xD5); // Set display clock
    OLED_SendCommand(0x80);
    OLED_SendCommand(0xA8); // Set multiplex ratio
    OLED_SendCommand(0x3F);
    OLED_SendCommand(0xD3); // Set display offset
    OLED_SendCommand(0x00);
    OLED_SendCommand(0x40); // Set start line
    OLED_SendCommand(0x8D); // Charge pump
    OLED_SendCommand(0x14);
    OLED_SendCommand(0x20); // Memory mode
    OLED_SendCommand(0x00);
    OLED_SendCommand(0xA1); // Segment remap
    OLED_SendCommand(0xC8); // COM scan direction
    OLED_SendCommand(0xDA); // COM pins
    OLED_SendCommand(0x12);
    OLED_SendCommand(0x81); // Contrast
    OLED_SendCommand(0xCF);
    OLED_SendCommand(0xD9); // Precharge
    OLED_SendCommand(0xF1);
    OLED_SendCommand(0xDB); // VCOM detect
    OLED_SendCommand(0x40);
    OLED_SendCommand(0xA4); // Resume display
    OLED_SendCommand(0xA6); // Normal display
    OLED_SendCommand(0xAF); // Display ON
    OLED_Clear();
}

//#define OLED_I2C_ADDR 0x78  // OLED I2C address (0x3C << 1)
//
//void OLED_SendCommand(uint8_t cmd) {
//    uint8_t data[2] = {0x00, cmd};
//    HAL_I2C_Master_Transmit(&hi2c1, OLED_I2C_ADDR, data, 2, HAL_MAX_DELAY);
//}
//
//void OLED_SendData(uint8_t data) {
//    uint8_t buf[2] = {0x40, data};
//    HAL_I2C_Master_Transmit(&hi2c1, OLED_I2C_ADDR, buf, 2, HAL_MAX_DELAY);
//}
